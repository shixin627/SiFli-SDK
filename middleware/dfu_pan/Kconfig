## middleware/dfu_pan/Kconfig
```kconfig
menuconfig USING_DFU_PAN
    bool "DFU via PAN"
    depends on BF0_HCPU
    default n
    help
        DFU (Device Firmware Update) via BT PAN allows firmware updates to be performed over a Bluetooth PAN connection
```

## middleware/dfu_uart/Kconfig
```kconfig
config BSP_USING_DFU_UART
    bool "DFU via UART"
    depends on BF0_HCPU
    default n
    help
        DFU (Device Firmware Update) via UART allows firmware updates to be performed over a UART connection
```

## middleware/elm_rw/Kconfig
```kconfig
config USING_ELM_RW
    bool "ELM_RW Module for UART File Transfer"
    default n
    help
        elm_rw is a module to communicate with PC for file transfer via UART.
```

## middleware/ezipa_dec/Kconfig
```kconfig
menuconfig USING_EZIPA_DEC
    bool "eZIP-A Decoder"
    default n
    if USING_EZIPA_DEC
        config EZIPA_MEM_CUSTOM
            bool "Use Custom malloc/free"
        config EZIPA_CUSTOM_INCLUDE_FILE
            string "Custom Include Header File"
            depends on EZIPA_MEM_CUSTOM
            default "custom_inc.h"
    endif
```

## middleware/ipc_queue/Kconfig
```kconfig
menuconfig USING_IPC_QUEUE
    bool "IPC Queue Library"
    default n
    
    config USING_IPC_QUEUE_DEVICE_WRAPPER
        bool "Enable Wrapper Device for IPC Queue Library"
        default n
        depends on USING_IPC_QUEUE
```

## middleware/mod_installer/Kconfig
```kconfig
config USING_MOD_INSTALLER
    bool "Module Installer"
    default n   
    depends on RT_USING_MODULE
    depends on RT_USING_XIP_MODULE
```

## middleware/partition_table/Kconfig
```kconfig
config USING_PARTITION_TABLE
    bool "Partition Table"
    default y if KCONFIG_V2
    default n if !KCONFIG_V2
    help
        Use partition table to manage all memory layout
```

## middleware/section_var/Kconfig
```kconfig
config USING_SECTION_ITER
        bool "Section Iterator"
        default n
    
```

## middleware/share_prefs/Kconfig
```kconfig
config BSP_SHARE_PREFS
    bool "Share Preferences"
    depends on PKG_USING_EASYFLASH || PKG_USING_FLASHDB
    default n
    help
        Share Preferences provides a unified storage interface, regardless of whether EasyFlash or FlashDB is used as the underlying storage backend.
```

## middleware/system/Kconfig
```kconfig
menuconfig BSP_USING_PM
    bool "Power Management (Low Power Configuration)"
    select RT_USING_PM
    select USING_CONTEXT_BACKUP if !SOC_SF32LB52X
    default n
if BSP_USING_PM
    config BSP_PM_STANDBY_SHUTDOWN
        bool "Use STANDBY as SHUTDOWN"
        default n
    config BSP_PM_DEBUG
        bool "Enable PM Debug"
        default n
    config BSP_PM_PIN_BACKUP_DISABLED
        bool "PIN Backup/Restore is disabled"
        default n
    menuconfig PM_METRICS_ENABLED
        bool "Enable PM Metrics"
        default n
        if PM_METRICS_ENABLED
            choice
                prompt "Select Metrics Report Type"
                default PM_METRICS_USE_COLLECTOR
                config PM_METRICS_USE_COLLECTOR
                    select USING_METRICS_COLLECTOR
                    bool "Save by Metrics Collector"
                config PM_METRICS_PRINT_DIRECTLY
                    bool "Print Directly"
            endchoice
            if PM_METRICS_PRINT_DIRECTLY
                config PM_METRICS_PRINT_PERIOD
                    int "Print period in second"
                    default 10
            endif 
        endif             
    config PM_WAKEUP_PIN_AS_OUTPUT_IN_SLEEP
        bool "Wakeup PIN is used as output PIN during sleep"
        default n
        depends on BF0_LCPU
    config BSP_PM_FREQ_SCALING
        bool "Enable frequency scaling, btim1 is used HCPU and btim3 is used by LCPU"
        default n
        select BSP_USING_BTIM1 if BF0_HCPU
        select BSP_USING_BTIM3 if BF0_LCPU
    config PM_ITCM_NOT_BACKUP
        bool "Not backup ITCM region when Sleep"
        default n
    config PM_USE_RC48
        bool "Use RC48 to save power"
        depends on BF0_LCPU
        default n
        select USING_CPU_USAGE_PROFILER
    config PM_LP_TIMER_DISABLE
        depends on BF0_LCPU
        bool "Disable low power timer in PM"
        default n
    config GUI_APP_PM
        bool "Use Gui_App_Pm"
        default n    
endif
```

## tools/sdk_py_actions/new_board/templates/58/acpu/Kconfig.board.jinja2
```kconfig
config {{ board_symbol }}
    bool
    select {{ soc_symbol }}
    select {{ core_select }}
{% if extra_select %}    select {{ extra_select }}
{% endif %}
    default y

rsource "../Kconfig.board"
```
