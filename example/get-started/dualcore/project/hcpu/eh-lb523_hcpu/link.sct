; *************************************************************
; *** Scatter-Loading Description File generated by Jinja2 ***
; *************************************************************



LR_IROM1 0x12020000 0x00580000  {    ; load region size_region
  ER_IROM1 0x12020000 0x00580000  {  ; load address = execution address
   *.o (RESET, +First)
   *(InRoot$$Sections)
   .ANY (+RO)
   *(FSymTab)
   *.o (.rodata.*)
  }
  ER_IROM1_EX 0x2007FC00 0x00000000  {  ; load address = execution address
   *.o (.l1_non_ret_text_*)
   *.o (.l1_non_ret_rodata_*)
  }  



  RW_IRAM_RET 0x20000000 0x00020000 {  
;    .ANY2 (+RW +ZI)    
   *.o (.l1_ret_text_*)
   *.o (.l1_ret_rodata_*)
   *.o (.bss.retm_bss_*)
   *.o (.retm_data_*)



   drv_spi_flash.o (+RO)
   flash.o (+RO)
   flash_table.o (.text.*)
   flash_table.o (.rodata.*)
   bf0_hal_hpaon.o (+RO)
   bf0_hal_mpi.o (+RO)
   bf0_hal_mpi_ex.o (+RO)
   bf0_hal_mpi_psram.o (+RO)
   drv_psram.o (+RO)
   context_rvds.o (+RO)
   drv_common.o (.text.HAL_GetTick)
 
   bf0_hal_rcc.o   (+RO)

   bf0_pm.o        (.text.sifli_light_handler)
   bf0_pm.o        (.text.sifli_deep_handler)
   bf0_pm.o        (.text.sifli_standby_handler)
   bf0_pm.o        (.text.SystemInitFromStandby)
   bf0_pm.o        (.text.SystemPowerOnModeGet)
   bf0_pm.o        (.text.BSP_GPIO_Set)

   bsp_init.o         (+RO)
   bsp_lcd_tp.o       (+RO)
   bsp_pinmux.o       (+RO)
   bsp_power.o        (+RO)
   bf0_hal_gpio.o     (+RO)
   bf0_hal.o          (.text.HAL_Init)
   *.o                (.text.HAL_Delay_us)
   *.o                (.text.HAL_Delay_us_)
   *.o                (.text.HAL_Delay_us2_)
   *.o                (.text.HAL_MspInit)
   *.o                (.text.HAL_Delay)
   bf0_hal_pinmux.o   (+RO)
   bf0_pin_const.o    (+RO)
   *.o                (.text.rt_memset)
   rt_memclr*.o (.text)
   memset*.o    (.text)  

   
  }

  RW_IRAM0 +0 UNINIT {  ; ZI data, not retained

    *.o (.l1_non_ret_data_*)
    *.o (.l1_non_ret_bss_*)

    *.o (.l2_non_ret_data_*)
    *.o (.l2_non_ret_bss_*)
    *.o (.l2_cache_non_ret_data_*)
    *.o (.l2_cache_non_ret_bss_*)
    *.o (.nand_cache)



    bf0_hal_epic.o (+RO)
    ;bf0_hal_epic_adv.o (+RO)
    bf0_hal_ezip.o (+RO)
    drv_epic.o (+RO)
    cell_transform.o (+RO)
    sqrt.o (+RO)

  }
  RW_IRAM1 +0  {  ; RW data  ,  retained
    ;*.o (Jlink_RTT, +First)
    *.o (.l1_ret_data_*)
    *.o (.l1_ret_bss_*)
   .ANY (+RW +ZI)
  }
  ScatterAssert(ImageLength(RW_IRAM_RET)+ImageLength(RW_IRAM0)+ImageLength(RW_IRAM1)<0x0007FC00)
}


LR_HCPU_FLASH2_IMG 0x125A0000 0x00100000  {  ; load region size_region
  ER_HCPU_FLASH2_IMG 0x125A0000 0x00100000  {  ; RW data

   *.o (.HCPU_FLASH2_IMG*)

   *.o (.ROM1_IMG*)

   *.o (.ROM3_IMG*)

   }
}

LR_HCPU_FLASH2_FONT 0x126A0000 0x00200000  {  ; load region size_region
  ER_HCPU_FLASH2_FONT 0x126A0000 0x00200000  {  ; RW data

   *.o (.HCPU_FLASH2_FONT*)

   *.o (.SECTION_TTF*)

   lvsf_font_*.o (.rodata*)

   }
}


;LR_IROM2 0x2007FC00 0x00000000  {    ; load region size_region
;  ER_IROM2 0x2007FC00 0x00000000  {  ; load address = execution address
;   *.o (.rodata.*)
;  }
;}

;LR_IROM3 PSRAM_BASE PSRAM_SIZE_HCPU  {  ; load region size_region
;  RW_IRAM6 PSRAM_BASE PSRAM_SIZE_HCPU  {  ; RW data
;   *.o (.ROM3_IMG)
;   }
;}


;LR_IROM3 RAM6_BASE RAM6_SIZE  {  ; load region size_region
;  RW_IRAM6 RAM6_BASE RAM6_SIZE  {  ; RW data
;   *.o (.bss.KWS_BUFFER1)
;   *.o (KWS_BIAS)
;  }
;  RW_IRAM7 RAM7_BASE RAM7_SIZE  {  ; RW data
;   *.o (KWS_WT)
;  }
;  RW_IRAM8 RAM8_BASE RAM8_SIZE  {  ; RW data
;   *.o (.bss.KWS_BUFFER2)
;   *.o (KWS_BIAS2)
;  }
;}
