## example/get-started/dualcore/project/hcpu/Kconfig.proj
```kconfig
source "../../src/modules/kconfig_module"
config BF0_HCPU
    bool
    default y
    
config CUSTOM_MEM_MAP
    bool 
    select custom_mem_map
    default y    
config SOLUTION_ALLOC_MEM
    bool
    default y

config FREETYPE_TINY_FONT_FULL
    bool
    default y

config EMOJI_SUPPORT
    bool "Enable emoji image rendering support"
    default y

menu "app cache Memory configuration"   

choice
    prompt "rotation image preferred cache memory"
    default  ROTATE_MEM_IN_PSRAM
    config ROTATE_MEM_IN_PSRAM
        depends on BSP_USING_PSRAM
        bool "PSRAM"
    config ROTATE_MEM_IN_SRAM
        bool "SRAM"
endchoice


choice
    prompt "freetype cache memory"
    default  FREETYPE_CACHE_IN_PSRAM
    config FREETYPE_CACHE_IN_PSRAM
        depends on BSP_USING_PSRAM
        bool "PSRAM"           
    config FREETYPE_CACHE_IN_SRAM_STANDALONE
        bool "SRAM STANDALONE"
    config FREETYPE_CACHE_IN_SRAM
        bool "SRAM(Share with system heap)"
endchoice


choice
    prompt "message preferred cache memory"
    default  MESSAGE_CACHE_IN_PSRAM
    config MESSAGE_CACHE_IN_PSRAM
        depends on BSP_USING_PSRAM
        bool "PSRAM"           
    config MESSAGE_CACHE_IN_SRAM_STANDALONE
        bool "SRAM STANDALONE"
    config MESSAGE_CACHE_IN_SRAM
         bool "SRAM(Share with system heap)"
endchoice


config IMAGE_CACHE_IN_PSRAM_SIZE
    int "image cache in psram size(standalone)"
    depends on BSP_USING_PSRAM
    default 2100000

config IMAGE_CACHE_IN_PSRAM_SIZE
    int
    depends on !BSP_USING_PSRAM
    default 0

config IMAGE_CACHE_IN_SRAM_SIZE
    int "image cache in sram size(standalone)"
    default 200000

    
config FT_CACHE_SIZE
    int "freetype cache size(bytes)"
    help 
        "Maximum freetype cache size(threshold), and define a standalon 
         array(size equals FT_CACHE_SIZE) if define 
         FREETYPE_CACHE_IN_PSRAM or FREETYPE_CACHE_IN_SRAM_STANDALONE"
    default 400000 if FREETYPE_CACHE_IN_PSRAM
    default 120000 if FREETYPE_CACHE_IN_SRAM_STANDALONE
    default 100000 if FREETYPE_CACHE_IN_SRAM


config MESSAGE_CACHE_SIZE
    int "message standalon cache size(bytes)"
    depends on MESSAGE_CACHE_IN_PSRAM || MESSAGE_CACHE_IN_SRAM_STANDALONE
    default 96000 if MESSAGE_CACHE_IN_PSRAM
    default 16000 if MESSAGE_CACHE_IN_SRAM_STANDALONE

# tiny_ttf is the v9 font path (see middleware/lvgl/lvsf_font_v9). These are
# project-local symbols in the SDK -- example/multimedia/lvgl/watch_v9 declares
# its own copy rather than there being a shared definition.
choice
    prompt "tiny ttf cache memory"
    default TINY_TTF_CACHE_IN_PSRAM
    config TINY_TTF_CACHE_IN_PSRAM
        depends on BSP_USING_PSRAM
        bool "PSRAM"
    config TINY_TTF_CACHE_IN_SRAM_STANDALONE
        bool "SRAM STANDALONE"
    config TINY_TTF_CACHE_IN_SRAM
        bool "SRAM(Share with system heap)"
endchoice

config TINY_TTF_CACHE_SIZE
    int "tiny ttf draw buf cache size(bytes)"
    help
        "Maximum tiny ttf draw buffer cache size, and define a standalone
         array(size equals TINY_TTF_CACHE_SIZE) if define
         TINY_TTF_CACHE_IN_PSRAM or TINY_TTF_CACHE_IN_SRAM_STANDALONE"
    default 120000 if TINY_TTF_CACHE_IN_PSRAM
    default 80000 if TINY_TTF_CACHE_IN_SRAM_STANDALONE
    default 60000 if TINY_TTF_CACHE_IN_SRAM

endmenu
```

## example/get-started/dualcore/src/modules/algorithm/kconfig
```kconfig
menu "Select algorithm"      
    config BSP_USING_AIR_MOUSE
			bool "Enable Air Mouse"
			default n
			
	config BSP_USING_MAHONY_AHRS
		bool "Enable MahonyAHRS"
		default n
		
	config BSP_USING_HAND_TRACKING
		bool "Enable Hand Tracking"
		default n

	config BSP_USING_GESTURE_DETECT
		bool "Enable gesture detection"
		default n

	if PKG_USING_ARDUINO_TENSORFLOW_LITE_MICRO
		config BSP_USING_GESTURE_RECOGNITION
			bool "Enable Gesture Recognition"
			default n
	endif

	config BSP_USING_SLEEP_FUSION
		bool "Enable in-tree sleep fusion (Cole-Kripke + HR staging)"
		default n

	config BSP_USING_SLEEP_VANHEES
		bool "Enable in-tree van Hees accel-only sleep-period detector"
		default n

	config BSP_USING_WEAR_DETECT
		bool "Enable wear detection (IMU + PPG)"
		default n
endmenu
```

## example/get-started/dualcore/src/modules/bloc/kconfig
```kconfig
menu "Select BLoc(Business Logic)"      
    config BSP_USING_BLOC
		bool "Enable bloc features"
		default n

	if BSP_USING_BLOC
		config BSP_USING_BLOC_CONTROL
			bool "Enable bloc control"
			default n

		config BSP_USING_BLOC_FLASH
			bool "Enable bloc flash"
			default n

		config BSP_USING_BLOC_NOTE
			bool "Enable bloc note"
			default n

		config BSP_USING_BLOC_CALENDAR
			bool "Enable bloc calendar"
			default n

		config BSP_USING_BLOC_NOTIFY
			bool "Enable bloc notification"
			default n

		config BSP_USING_BLOC_SETTING
			bool "Enable bloc setting"
			default n

		config BSP_USING_BLOC_SKAIWALK
			bool "Enable bloc skaiwalk"
			default n

		config BSP_USING_BLOC_V2T
			bool "Enable bloc voice to text"
			default n

		config BSP_USING_BLOC_MOTOR
			bool "Enable bloc motor"
			default n

		config BSP_USING_BLOC_BATTERY
			bool "Enable bloc battery"
			default n

		config BSP_USING_BLOC_PERIPHERAL
			bool "Enable bloc peripheral"
			default n
			
		config BSP_USING_BLOC_WEATHER
			bool "Enable bloc weather"
			default n

		config BSP_USING_BLOC_MOTION_TRACKING
			bool "Enable bloc motion tracking"
			default n

		config BSP_USING_BLOC_FILESYSTEM
			bool "Enable bloc file system"
			default n

		config BSP_USING_BLOC_SYSTEM_PERCEPTION
			bool "Enable bloc system perception"
			default n

		config BSP_USING_BLOC_EXERCISE
			bool "Enable bloc exercise"
			default n

		config BSP_USING_BLOC_RGB_LED
			bool "Enable bloc rgb led"
			default n
	endif
endmenu
```

## example/get-started/dualcore/src/modules/client/kconfig
```kconfig
menu "Select data client"      
    if BSP_USING_DATA_SVC
		config BSP_USING_IMU_CLIENT
			bool "Enable IMU Client"
			default n

		config BSP_USING_HR_CLIENT
			bool "Enable HR Client"
			default n

		config BSP_USING_WATCH_SYS_CLIENT
			bool "Enable Watch System Client"
			default n

		config BSP_USING_ALARM_CLIENT
			bool "Enable Alarm Client"
			default n
	endif
endmenu
```

## example/get-started/dualcore/src/modules/communicate/kconfig
```kconfig
menu "Select Communicatie"      
    if BSP_BLE_SIBLES
		config BSP_USING_COMMUNICATE
			bool "Enable communication features"
			default n

		if BSP_USING_COMMUNICATE
			config BSP_USING_COMM_BOND
				bool "Enable bond resolver"
				default n

			config BSP_USING_COMM_CONTROL
				bool "Enable control resolver"
				default n

			config BSP_USING_COMM_HEALTH
				bool "Enable health resolver"
				default n

			config BSP_USING_COMM_NOTIFY
				bool "Enable notify resolver"
				default n

			config BSP_USING_COMM_SETTING
				bool "Enable setting resolver"
				default n

			config BSP_USING_COMM_SKAILINK
				bool "Enable skailink device-sync resolver (ADR-0008)"
				default n

			config BSP_USING_COMM_DFU
				bool "Enable DFU resolver"
				default n

			config BSP_USING_BLE_LOG
				bool "Enable ble log debugger"
				default n
		endif
	endif
endmenu
```

## example/get-started/dualcore/src/modules/model/kconfig
```kconfig
menu "Select Model"      
    config BSP_USING_MODEL_WATCH_GLOBAL_DATA
		bool "Enable Watch Global Data Model"
		default n

	config BSP_USING_MODEL_WATCH_SYS_INTERACT
		bool "Enable Watch System Interaction Model"
		default n

	config BSP_USING_UI_HANDLER
		bool "Enable Watch UI Handler"
		default n

	config BSP_USING_GESTURE_HANDLER
		bool "Enable Watch Gesture Handler"
		default n
	
	config BSP_USING_VIRTUAL_CONSOLE
		bool "Enable Virtual Console"
		default n

	config BSP_USING_TOUCH_STATE_MANAGER
		bool "Enable Touch state manager"
		default n

	config BSP_USING_AUDIO_PROCESSOR
		bool "Enable Audio Processor"
		default n

	config BSP_USING_BLE_DEVICE_MANAGER
		bool "Enable BLE Device Manager"
		default n

	config BSP_USING_BLE_HID
		bool "Enable BLE HID"
		default n

	config BSP_USING_BLE_LOG
		bool "Enable BLE LOG"
		default n
endmenu
```

## example/get-started/dualcore/src/modules/service/kconfig
```kconfig
menu "Select data service"      
    if BSP_USING_DATA_SVC
        config BSP_USING_HR_SVC
            bool "Enable HR Service"
            select SENSOR_USING_HR
            default n

        config BSP_USING_ACCE_SVC
            bool "Enable Accelerator Service"
            select ACC_USING_BMI270
            default n

        config BSP_USING_ALARM_MANAGER_SVC
            bool "Enable alarm manager Service"
            default n   
        if BSP_USING_ALARM_MANAGER_SVC
            config BSP_ALARM_MAX
                int "Max number of Alarm could set"
                default 8          
        endif
		
		config BSP_USING_WATCHSYS_SVC
            bool "Enable watch system Service"
            default n  
    endif        
endmenu
```

## example/get-started/dualcore/src/modules/tests/kconfig
```kconfig
menu "Unit testing"
    config BSP_USING_UNIT_TEST
		bool "Enable Unit Testing"
		default n
    
    if BSP_USING_UNIT_TEST
        config UNIT_TEST_FS
            bool "test file system"
            default n

        config UNIT_TEST_SHARE_PREFS
            bool "test share prefs"
            default n

        config UNIT_TEST_ADC
            bool "test adc"
            default n

        config UNIT_TEST_MOTOR
            bool "test motor"
            default n

        config UNIT_TEST_NNACC
            bool "test NNACC"
            default n
    endif

endmenu
```
