## customer/peripherals/sd/Kconfig
```kconfig
menu "SD Card"

config SD_INSERT_DETECT_PIN
    int  "SD Card Insert Detection Pin"
    default -1

endmenu
```

## example/acpu/project/Kconfig.proj
```kconfig
config BF0_HCPU
    bool
    default n

config BF0_ACPU
    bool
    default y
    
config CUSTOM_MEM_MAP
    bool 
	default y    
```

## example/boot_loader/project/sf32lb57x/rom/Kconfig
```kconfig
mainmenu "Sifli Configuration"

config SIFLI_SDK
    string 
    option env="SIFLI_SDK"
    default "."

#SDK configuration	
source "$SIFLI_SDK/Kconfig"

#Application specific configuration
config BF0_HCPU
    bool
    default y
    
config CFG_BOOTLOADER
    bool
    default y
config CFG_BOOTROM
    bool
    default y
config SD_BOOT
    bool
    default y
    
```

## example/cherryusb/device/msc/sdcard_disk/project/Kconfig.proj
```kconfig
#APP specific configuration.
config CUSTOM_MEM_MAP
    bool 
	select custom_mem_map
	default y if !SOC_SIMULATOR

choice CHERRYUSB_MSC_BACKEND
    prompt "CherryUSB MSC storage backend"
    default CHERRYUSB_MSC_BACKEND_SDIO if BSP_USING_SDIO
    default CHERRYUSB_MSC_BACKEND_SPI_MSD

    config CHERRYUSB_MSC_BACKEND_SPI_MSD
        bool "SPI SD/TF card through RT_USING_SPI_MSD"

    config CHERRYUSB_MSC_BACKEND_SDIO
        bool "SDIO/MMC block device"
endchoice
```

## example/lcpu_rom/Kconfig.proj
```kconfig
config CUSTOM_MEM_MAP
    bool 
	select custom_mem_map
	default y    

config ROM_ATTR
    bool 
	default y

config LCPU_INIT_ON_ROM    
    bool
    default y
```

## example/multimedia/lvgl/ezip/project/Kconfig.proj
```kconfig
#APP specific configuration.
config CUSTOM_MEM_MAP
    bool 
    select custom_mem_map
    default y if !SOC_SIMULATOR

config IMAGE_CACHE_IN_PSRAM_SIZE
    int "image cache in psram size(standalone)"
    depends on BSP_USING_PSRAM
    default 262144

config IMAGE_CACHE_IN_PSRAM_SIZE
    int
    depends on !BSP_USING_PSRAM
    default 0

choice EZIP_SDCARD_BACKEND
    prompt "EZIP SD card storage backend"
    default EZIP_SDCARD_BACKEND_SDIO if BSP_USING_SDIO
    default EZIP_SDCARD_BACKEND_SPI_MSD

    config EZIP_SDCARD_BACKEND_SPI_MSD
        bool "SPI SD/TF card through RT_USING_SPI_MSD"

    config EZIP_SDCARD_BACKEND_SDIO
        bool "SDIO/MMC block device"
endchoice

config EZIP_SDCARD_DEVNAME
    string "EZIP SD card block device name"
    default "sd0"
```

## example/multimedia/lvgl/watch_v9/project/Kconfig.proj
```kconfig
#APP specific configuration.
config CUSTOM_MEM_MAP
    bool 
	select custom_mem_map
	default y if !SOC_SIMULATOR

config SOLUTION_ALLOC_MEM
    bool
    default y

menu "app cache Memory configuration"   

choice
    prompt "rotation image preferred cache memory"
    default  ROTATE_MEM_IN_PSRAM
    config ROTATE_MEM_IN_PSRAM
        depends on BSP_USING_PSRAM
        bool "PSRAM"
    config ROTATE_MEM_IN_SRAM
        bool "SRAM"
endchoice

choice
    prompt "tiny ttf cache memory"
    default  TINY_TTF_CACHE_IN_PSRAM
    config TINY_TTF_CACHE_IN_PSRAM
        depends on BSP_USING_PSRAM
        bool "PSRAM"
    config TINY_TTF_CACHE_IN_SRAM_STANDALONE
        bool "SRAM STANDALONE"
    config TINY_TTF_CACHE_IN_SRAM
        bool "SRAM(Share with system heap)"
endchoice


choice
    prompt "message preferred cache memory"
    default  MESSAGE_CACHE_IN_PSRAM
    config MESSAGE_CACHE_IN_PSRAM
        depends on BSP_USING_PSRAM
        bool "PSRAM"           
    config MESSAGE_CACHE_IN_SRAM_STANDALONE
        bool "SRAM STANDALONE"
    config MESSAGE_CACHE_IN_SRAM
         bool "SRAM(Share with system heap)"
endchoice


config IMAGE_CACHE_IN_PSRAM_SIZE
    int "image cache in psram size(standalone)"
    depends on BSP_USING_PSRAM
    default 2100000

config IMAGE_CACHE_IN_PSRAM_SIZE
    int
    depends on !BSP_USING_PSRAM
    default 0

config IMAGE_CACHE_IN_SRAM_SIZE
    int "image cache in sram size(standalone)"
    default 200000


config TINY_TTF_CACHE_SIZE
    int "tiny ttf draw buf cache size(bytes)"
    help
        "Maximum tiny ttf draw buffer cache size, and define a standalone
         array(size equals TINY_TTF_CACHE_SIZE) if define
         TINY_TTF_CACHE_IN_PSRAM or TINY_TTF_CACHE_IN_SRAM_STANDALONE"
    default 120000 if TINY_TTF_CACHE_IN_PSRAM
    default 80000 if TINY_TTF_CACHE_IN_SRAM_STANDALONE
    default 60000 if TINY_TTF_CACHE_IN_SRAM


config MESSAGE_CACHE_SIZE
    int "message standalon cache size(bytes)"
    depends on MESSAGE_CACHE_IN_PSRAM || MESSAGE_CACHE_IN_SRAM_STANDALONE
    default 96000 if MESSAGE_CACHE_IN_PSRAM
    default 16000 if MESSAGE_CACHE_IN_SRAM_STANDALONE


endmenu
```

## example/zbt/mesh_group_demo_provisioner/project/Kconfig.proj
```kconfig
#APP specific configuration.
config CUSTOM_MEM_MAP
    bool 
	select custom_mem_map
	default y

config MESH_INFO_SAVE_TO_BLE_NV
    bool 
	default y
```

## external/Kraepelin/Kconfig
```kconfig
menu "Kraepelin"  

config PKG_USING_KRAEPELIN
    bool "Enable kraepelin algorithm"
    default n

config PKG_USING_KRAEPELIN_REFERENCE
    bool "Using kraepelin reference"
    depends on PKG_USING_KRAEPELIN
    help
        Select this option to use the references of kraepelin algorithm.

endmenu
```

## external/TensorFlow-Lite-Micro/Kconfig
```kconfig
menu "Tensorflow Lite Micro"  

config PKG_USING_ARDUINO_TENSORFLOW_LITE_MICRO
    bool "Enable Tensorflow Lite Micro"
    default n

config PKG_USING_TENSORFLOW_LITE_MICRO_CMSISNN
    bool "Using Tensorflow Lite CMSIS NN operations"
    depends on PKG_USING_ARDUINO_TENSORFLOW_LITE_MICRO
    help
        Select this option to use the CMSIS NN implementations of the Tensorflow Lite Micro operations.

endmenu
```

## middleware/acpu_ctrl/Kconfig
```kconfig
menuconfig USING_ACPU_CTRL_FWK
    bool "ACPU Control Framework"
    select USING_IPC_QUEUE
    select BSP_USING_ACPU
    default n
if USING_ACPU_CTRL_FWK
    config ACPU_CALLER_ENABLED
        bool "Enable Caller"
        default y if BF0_HCPU
endif
```

## middleware/app_fwk/Kconfig
```kconfig
menuconfig GUI_APP_FRAMEWORK
    bool "GUI Application Framework"
    default n
    if GUI_APP_FRAMEWORK
        choice
            prompt "App switch animation type"
            default APP_TRANS_ANIMATION_SCALE
            config APP_TRANS_ANIMATION_NONE
                bool "No animation (0 buffer)"
            config APP_TRANS_ANIMATION_OVERWRITE
                bool "Overwrite animation (0 buffer)"
                select LVSF_USING_SWITCHANIM
            config APP_TRANS_ANIMATION_SCALE
                bool "Enlarge/Shrink Animation (2 buffers)"
                select LVSF_USING_SWITCHANIM
        endchoice

        config GUI_MAX_RUNNING_APPS
            int "max running GUI apps at same time"
            default 2
            
        config GUI_PM_METRICS_ENABLED    
            bool "Enable GUI PM Metrics"
            default n
    endif
```

## middleware/barcode128/Kconfig
```kconfig
config USING_BARCODE128
    bool "Barcode128 Library"
    default y if PKG_USING_LITTLEVGL2RTT
```

## middleware/boot/Kconfig
```kconfig
menuconfig USING_SECBOOT
    bool "Secure Boot Module for Bootloader"
    default n

if USING_SECBOOT
    config SECBOOT_USING_APP_IMG_SIG_VERIFIY
        bool "APP Image Signature Verfication Enabled"
        default n
    config SECBOOT_APP_IMG_SIG_BY_UID_ENABLD
        bool "APP Image Signature Generated with UID"
        default n
        depends on SECBOOT_USING_APP_IMG_SIG_VERIFIY
endif
```

## middleware/button/Kconfig
```kconfig
menuconfig USING_BUTTON_LIB
    bool "Button Library"
    select RT_USING_PIN
    default n
    
    if USING_BUTTON_LIB
    
        config BUTTON_MAX_NUM
            int "max button number"
            default 2
        
        config BUTTON_ADV_ACTION_CHECK_DELAY
            int "detection time for advanced action in millisecond"
            default 3000
        config BUTTON_SERVICE_ENABLED
            bool "Register Button as Data Service"
            default n
        if BUTTON_SERVICE_ENABLED  
            config BUTTON_SERVICE_MAX_CLIENT_NUM
                int "max number of supported clients"
                default 1
        endif
        menuconfig USING_ADC_BUTTON
            bool "Enable ADC Buttons"
            default n
            if USING_ADC_BUTTON
                config ADC_BUTTON_GROUP_NUM
                    int "Number of ADC Button Groups"
                    default 1
                config ADC_BUTTON_ADC_DEV_NAME
                    string "ADC Device Name"
                    default "bat1"
                if ADC_BUTTON_GROUP_NUM > 0
                comment "----------- Button Group1 ------------"    
                    config ADC_BUTTON_GROUP1_MAX_NUM
                        int "Number of Buttons in Group1"
                        default 2
                    config ADC_BUTTON_GROUP1_ADC_DEV_CHANNEL
                        int "ADC Device Channel"
                        default 7
                    if ADC_BUTTON_GROUP1_MAX_NUM > 0
                        config ADC_BUTTON_GROUP1_BUTTON1_VOLT
                            int "ADC Button1 Voltage (mV)"
                            default 1000
                        config ADC_BUTTON_GROUP1_BUTTON1_RANGE
                            int "ADC Button1 Voltage Valid Range (mV)"
                            default 50
                    endif     
                    if ADC_BUTTON_GROUP1_MAX_NUM > 1
                        config ADC_BUTTON_GROUP1_BUTTON2_VOLT
                            int "ADC Button2 Voltage (mV)"
                            default 1000
                        config ADC_BUTTON_GROUP1_BUTTON2_RANGE
                            int "ADC Button2 Voltage Valid Range (mV)"
                            default 50
                    endif     
                    if ADC_BUTTON_GROUP1_MAX_NUM > 2
                        config ADC_BUTTON_GROUP1_BUTTON3_VOLT
                            int "ADC Button3 Voltage (mV)"
                            default 1000
                        config ADC_BUTTON_GROUP1_BUTTON3_RANGE
                            int "ADC Button3 Voltage Valid Range (mV)"
                            default 50
                    endif     
                endif  
                if ADC_BUTTON_GROUP_NUM > 1
                comment "----------- Button Group2 ------------"                        
                    config ADC_BUTTON_GROUP2_MAX_NUM
                        int "Number of Buttons in Group1"
                        default 2
                    config ADC_BUTTON_GROUP2_ADC_DEV_CHANNEL
                        int "ADC Device Channel"
                        default 7
                    if ADC_BUTTON_GROUP2_MAX_NUM > 0
                        config ADC_BUTTON_GROUP2_BUTTON1_VOLT
                            int "ADC Button1 Voltage (mV)"
                            default 1000
                        config ADC_BUTTON_GROUP2_BUTTON1_RANGE
                            int "ADC Button1 Voltage Valid Range (mV)"
                            default 50
                    endif     
                    if ADC_BUTTON_GROUP2_MAX_NUM > 1
                        config ADC_BUTTON_GROUP2_BUTTON2_VOLT
                            int "ADC Button2 Voltage (mV)"
                            default 1000
                        config ADC_BUTTON_GROUP2_BUTTON2_RANGE
                            int "ADC Button2 Voltage Valid Range (mV)"
                            default 50
                    endif     
                    if ADC_BUTTON_GROUP2_MAX_NUM > 2
                        config ADC_BUTTON_GROUP2_BUTTON3_VOLT
                            int "ADC Button3 Voltage (mV)"
                            default 1000
                        config ADC_BUTTON_GROUP2_BUTTON3_RANGE
                            int "ADC Button3 Voltage Valid Range (mV)"
                            default 50
                    endif     
                endif                     
            endif         
    endif
```

## middleware/cmsis_dsp/Kconfig
```kconfig
config USING_CMSIS_DSP_ACC
    bool "CMSIS DSP Acceleration"
    depends on SOC_SF32LB58X || SOC_SF32LB56X
    select BSP_USING_CMSIS_DSP
    default n
```

## middleware/context_backup/Kconfig
```kconfig
menuconfig USING_CONTEXT_BACKUP
    bool "Context Backup"
    default n 
    if USING_CONTEXT_BACKUP
    config CONTEXT_BACKUP_COMPRESSION_ENABLED
        bool "Enable compression"
        default n
        select PKG_USING_LZ4
    endif
```

## middleware/core_dump/Kconfig
```kconfig
menuconfig USING_CORE_DUMP
    bool "Use Core Dump"
    default n   

if USING_CORE_DUMP
    config USING_CORE_DUMP_EXT
    bool "Enable extended core dump function"
    help
       Extended core dump function that can be implemented by user
    
    default n
endif # USING_CORE_DUMP
```

## middleware/cpu_usage_profiler/Kconfig
```kconfig
menuconfig USING_CPU_USAGE_PROFILER
    bool "CPU Usage Profiler"
    default n   
    if USING_CPU_USAGE_PROFILER
        config CPU_PROFILER_MAX_THREAD_SWITCH_HIST_LEN
            int "Thread switch history recording number"
            default 64
        config CPU_PROFILER_RECORD_ISR_HISTORY_ENABLED
            bool "Enable ISR History Recording"
            default n
            config CPU_PROFILER_MAX_ISR_HIST_LEN
                int "ISR history recording number"
                default 16
                depends on CPU_PROFILER_RECORD_ISR_HISTORY_ENABLED
        config CPU_USAGE_METRICS_ENABLED
            bool "Enable CPU Usage Metrics"
            # pthread uses user_data which is used by metrics to record thread run time
            depends on !RT_USING_PTHREADS
            default n
            
            if CPU_USAGE_METRICS_ENABLED
                choice
                    prompt "Select Metrics Report Type"
                    default CPU_USAGE_METRICS_USE_COLLECTOR
                    config CPU_USAGE_METRICS_USE_COLLECTOR
                        select USING_METRICS_COLLECTOR
                        bool "Save by Metrics Collector"
                    config CPU_USAGE_METRICS_PRINT_DIRECTLY
                        bool "Print Periodically"
                    config CPU_USAGE_METRICS_PRINT_MANUALLY
                        bool "Print Manually"
                endchoice
                if CPU_USAGE_METRICS_PRINT_DIRECTLY
                    config CPU_USAGE_METRICS_PRINT_PERIOD
                        int "Print period in second"
                        default 10
                endif 
            endif    
    endif
```

## middleware/crypto/Kconfig
```kconfig
menuconfig USING_SF_CRYPTO
    bool "Cryptography Module by SiFli"
    default n

    if USING_SF_CRYPTO
        choice SF_CRYPTO_PORT
            prompt "Select Driver Type"
            default SF_CRYPTO_PORT_OS
            config SF_CRYPTO_PORT_BAREMETAL
                bool "Baremetal, no OS dependency but not thread-safe"
            config SF_CRYPTO_PORT_OS
                bool "OS, Depend on RT-Thread"
        endchoice
    endif
```
