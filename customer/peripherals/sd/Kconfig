## middleware/data_bus/Kconfig
```kconfig
menuconfig BSP_USING_DATA_SVC
    bool "Data Service"
    default n
    if BSP_USING_DATA_SVC
        config DATA_SVC_MBOX_THREAD_STACK_SIZE
            int "MBOX Thread stack size in byte"
            default 1024
        config DATA_SVC_MBOX_THREAD_DYNAMIC
            bool "Use Dynamic MBOX Thread stack"
            default n 
        config DATA_SVC_MBOX_THREAD_PRIORITY
            int "MBOX Thread Priority"
            default 13
            
        config DATA_SVC_PROC_THREAD_STACK_SIZE
            int "Proc Thread stack size in byte"
            default 4096 if BF0_HCPU
            default 2048 if BF0_LCPU
            default 2048 if BSP_USING_PC_SIMULATOR
            
        config DATA_SVC_PROC_THREAD_DYNAMIC
            bool "Use Dynamic Proc Thread stack"
            default n 
        config DATA_SVC_PROC_THREAD_PRIORITY
            int "Proc Thread Priority"
            default 14
        config DATA_SVC_MBOX_THREAD_DISABLED
            bool "Disable MBOX Thread and Related Queue"
            default y if SOC_SF32LB52X
            default n
        config DATA_SVC_PROC_THREAD_DISABLED
            bool "Disable Proc Thread and Related Queue"
            default n
            depends on DATA_SVC_MBOX_THREAD_DISABLED
    endif
    
    if BSP_USING_DATA_SVC
        config BSP_USING_ANCS_SVC
        bool "Enable ANCS Service"
        select BSP_BLE_SIBLES
        select BSP_BLE_ANCS
        default n
    endif
    if BSP_USING_DATA_SVC
        config BSP_USING_BLE_NVDS_SVC
        bool "Enable ble nvds Service"
        depends on PKG_USING_EASYFLASH || PKG_USING_FLASHDB
        default n
        config NVDS_AUTO_UPDATE_MAC_ADDRESS
        bool "Using MAC address from product area"
        default n
        depends on BSP_USING_BLE_NVDS_SVC
    endif
    if BSP_USING_DATA_SVC
        config BSP_USING_BLE_DFU_PORT_SVC
        bool "Enable DFU port service"
        select BSP_BLE_SIBLES
        default n
    endif
    if BSP_USING_DATA_SVC
        config BSP_USING_AMS_SVC
        bool "Enable AMS Service"
        select BSP_BLE_SIBLES
        select BSP_BLE_AMS
        default n
    endif
```

## middleware/dfu/Kconfig
```kconfig
menuconfig BSP_USING_DFU
    bool "DFU Support"
    depends on BF0_HCPU
    default n    
    help
        DFU (Device Firmware Update) Support
if BSP_USING_DFU
    config BSP_USING_DFU_COMPRESS
        bool "Device firmware using compress"
        default n
    config DFU_DECOMPRESS_USING_SOFTWARE
        bool "Use software function to decompress zlib ota code"
        depends on BSP_USING_DFU_COMPRESS
        default n
    config DFU_USING_DOWNLOAD_BACKUP
        bool "Backup for ota download content"
        default n
        if DFU_USING_DOWNLOAD_BACKUP
            config DFU_USING_BACK_UP_FLASH
            bool "Store backup content on flash"
            depends on BSP_USING_DFU_COMPRESS
            default n
        endif
        if DFU_USING_DOWNLOAD_BACKUP
            config DFU_USING_BACK_UP_PSRAM
            bool "Store backup content on psram"
            depends on BSP_USING_DFU_COMPRESS
            default n
        endif
    config OTA_SECTION_CHANGE
        bool "Support change image download address"
        default n
    config OTA_ERROR_HANDLE_IN_USR
        bool "OTA error handle in user bin"
        default n
    config OTA_USING_SOL_FUNC
        bool "OTA will use solution's version check and power off function"
        default n
    config OTA_55X
        bool "NOR flash OTA"
        default n
        if OTA_55X
            config OTA_NOR_OTA_MANAGER_LITE
            bool "support lite or none ota manager"
            default n
        endif
    config OTA_56X_NAND
        bool "NAND flash OTA"
        default n
        if OTA_56X_NAND
            config OTA_NAND_ONLY
            bool "Support nand only board"
            default n
        endif
    config OTA_NOR_LCPU_ROM_PATCH_SIZE
        int "nor ota lcpu rom patch download size"
        depends on DFU_USING_BACK_UP_FLASH
        default 8192
    config DFU_LCPU_ROM_PATCH_COMPARE
        bool "skip update lcpu rom patch if compare result is the same"
        depends on DFU_USING_BACK_UP_FLASH
        default n
endif
```
