## Kconfig.v2
```kconfig
mainmenu "Sifli Configuration"

config SIFLI_SDK
    string 
    option env="SIFLI_SDK"
    default "."

config KCONFIG_V2
    bool 
    default y

#SDK configuration	
source "$SIFLI_SDK/rtos/Kconfig"
source "$SIFLI_SDK/middleware/Kconfig"
source "$SIFLI_SDK/external/Kconfig"
osource "$PKGS_ROOT/packages/Kconfig"

menu "Build Options"
    config USING_MICROLIB
        bool "Use microlib"
        default n
    menu "Optimization Level"
        choice OPT_LEVEL
            prompt ""
            default OPT_LEVEL_SIZE
            config OPT_LEVEL_0
                bool "-O0"
            config OPT_LEVEL_1
                bool "-O1"
            config OPT_LEVEL_2
                bool "-O2"
            config OPT_LEVEL_3
                bool "-O3"
            config OPT_LEVEL_FAST
                bool "-Ofast"                
            config OPT_LEVEL_BALANCED
                bool "-Os balanced"                                
            config OPT_LEVEL_SIZE
                bool "-Oz size"
        endchoice
        config OPT_LEVEL
            string
            default "-O0" if OPT_LEVEL_0
            default "-O1" if OPT_LEVEL_1
            default "-O2" if OPT_LEVEL_2
            default "-O3" if OPT_LEVEL_3
            default "-Ofast" if OPT_LEVEL_FAST
            default "-Os" if OPT_LEVEL_BALANCED
            default "-Oz" if OPT_LEVEL_SIZE
    endmenu
    config USING_CPLUSPLUS
        bool "Support C++"
        default n
    config STARTUP_STACK_SIZE
        int "Stack Size (byte) for Main Stack"
        default 221184 if BSP_USING_NO_OS && SOC_SF32LB58X
        default 8192
    config STARTUP_HEAP_SIZE
        int "Heap Size (byte) used by standard lib"
        default 65536 if BSP_USING_NO_OS && SOC_SF32LB58X
        default 3072
endmenu
```

## customer/boards/Kconfig.v2
```kconfig
config KCONFIG_BOARD_V2
    bool 
    default y
source "$SIFLI_SDK/customer/boards/Kconfig_soc"
source "$SIFLI_SDK/customer/boards/Kconfig_drv"
menu "Config LCD on board"
    config BSP_USING_LCD
        bool "Enable LCD on the board"
        select BSP_USING_LCDC
        default n

    if !FPGA
        source "$SIFLI_SDK/customer/boards/Kconfig_lcd"
    endif
    if FPGA
        source "$SIFLI_SDK/customer/boards/Kconfig_lcd_fpga"
    endif
endmenu
menu "Board Peripherals"
source "$SIFLI_SDK/customer/peripherals/Kconfig"
endmenu

    
```

## customer/boards/ec-lb561xxx/Kconfig
```kconfig
config ASIC
    bool
    default y
   
config TOUCH_IRQ_PIN
    default 50

config LCD_PWM_BACKLIGHT_INTERFACE_NAME
    string
    default "pwmt1"

config LCD_PWM_BACKLIGHT_CHANEL_NUM
    int
    default 4

config LCD_BACKLIGHT_CONTROL_PIN
    int
    default 31
```

## customer/boards/fpga-57x_emmc/hcpu/Kconfig.board
```kconfig
config BSP_USING_BOARD_FPGA_57X_EMMC
    bool
    select SOC_SF32LB57X
    select BF0_HCPU
    default y

rsource "../Kconfig.board"
```

## customer/boards/fpga-57x_emmc/lcpu/Kconfig.board
```kconfig
config BSP_USING_BOARD_FPGA_57X_SD
    bool
    select SOC_SF32LB57X
    select BF0_LCPU
    default y

rsource "../Kconfig.board"
```

## customer/boards/fpga-57x_mem_v3/hcpu/Kconfig.board
```kconfig
config BSP_USING_BOARD_FPGA_57X_MEM_V3
    bool
    select SOC_SF32LB57X
    select BF0_HCPU
    default y

rsource "../Kconfig.board"
```

## customer/boards/fpga-57x_mem_v3_mpi2/hcpu/Kconfig.board
```kconfig
config BSP_USING_BOARD_FPGA_57X_MEM_V3_MPI2
    bool
    select SOC_SF32LB57X
    select BF0_HCPU
    default y

rsource "../Kconfig.board"
```

## customer/boards/fpga-57x_mem_v3_nand/lcpu/Kconfig.board
```kconfig
config BSP_USING_BOARD_FPGA_57X_MEM_V3_NAND
    bool
    select SOC_SF32LB57X
    select BF0_LCPU
    default y

rsource "../Kconfig.board"
```

## customer/boards/fpga-57x_mem_v3_nand_4k/acpu/Kconfig.board
```kconfig
config BSP_USING_BOARD_FPGA_57X_MEM_V3_NAND_4K
    bool
    select SOC_SF32LB57X
    select BF0_ACPU
    select BF0_HCPU
    default y

rsource "../Kconfig.board"
```

## customer/boards/fpga-57x_mem_v3_nand_4k/hcpu/Kconfig.board
```kconfig
config BSP_USING_BOARD_FPGA_57X_MEM_V3_NAND_4K
    bool
    select SOC_SF32LB57X
    select BF0_HCPU
    default y

config FLASH_CONFIG_PAGE_SIZE
    int
    default 4096

config FLASH_CONFIG_BLOCK_SIZE
    int
    default 262144

rsource "../Kconfig.board"
```

## customer/boards/sf32lb56-devkit-lcd_a128r12n1/lcpu/Kconfig.board
```kconfig
config BSP_USING_BOARD_56_DEVKIT_LCD_NAND
    bool
    select SOC_SF32LB56X
    select BF0_LCPU
    default y

rsource "../Kconfig.board"
```

## customer/boards/sf32lb56-watch_base/Kconfig.board
```kconfig
config ASIC
    bool 
    default y 
   
config TOUCH_IRQ_PIN
    int
    default 50

config LCD_PWM_BACKLIGHT_INTERFACE_NAME
    string
    default "pwm4"

config LCD_PWM_BACKLIGHT_CHANEL_NUM
    int
    default 4

config LCD_BACKLIGHT_CONTROL_PIN
    int
    default 122    
    
config LCD_USE_GPIO_TE
    int
    depends on LCD_CO5300_VSYNC_ENABLE
    default 33
```

## customer/boards/sf32lb56-wlan-core_a128r12n1/hcpu/Kconfig.board
```kconfig
config BSP_USING_BOARD_SF32LB56_WLAN_CORE_A128R12N1
    bool
    select SOC_SF32LB56X
    select BF0_HCPU
    default y

rsource "../Kconfig.board"
```

## customer/peripherals/battery/Kconfig
```kconfig
menu "Battery"
menuconfig BSP_USING_VBAT
    bool "VBAT measured by ADC"
    default n
    if BSP_USING_VBAT  
        config BSP_VBAT_ADC_PIN
            int "VBAT PIN number"
            default 123
        config BSP_VBAT_ADC_CHN
            int "ADC channel for VBAT"
            default 5
        config VBAT2ADC_KOHM
            int "Impedance between VBAT to ADC PIN"
            default 470
        config GND2ADC_KOHM
            int "Impedance between GND to ADC PIN"
            default 1000
    endif 

endmenu
```

## customer/peripherals/charger/Kconfig
```kconfig
menuconfig BSP_USING_CHARGER
    depends on RT_USING_PIN
    bool "Charger"
    default n
    if BSP_USING_CHARGER  
        choice
            prompt "Charger Device"
            default CHARGE_USING_SIFLI if SOC_SF32LB52X
            default CHARGE_USING_SGM40561 if !SOC_SF32LB52X
            config CHARGE_USING_SIFLI
                depends on SOC_SF32LB52X
                bool "SF32LB52X builtin charger"
            config CHARGE_USING_SGM40561
                bool "SGM40561 charger"
            config CHARGE_USING_AW32001
                bool "AW32001 charger"
            config CHARGE_USING_SIMPLE_CHARGE
                bool "Simple charger"
                help
                   Simple charger has no control interface, it cannot be configured with charge current, 
                   charge full voltage, etc. 
        endchoice
        choice
            prompt "Charger Measure VBAT ADC Mode"
            default CHARGER_MEASURE_MODE_SUSPEND
            config CHARGER_MEASURE_MODE_SUSPEND    
            bool "Charger Measure VBAT ADC Mode Suspend"
            config CHARGER_MEASURE_MODE_CURVE    
            bool "Charger Measure VBAT ADC Mode CURVE"
        endchoice          
        menuconfig CHARGE_PIN_CONFIG
            bool "Charger pin number config -1:invalid >=0:valid"
            default y
            if CHARGE_PIN_CONFIG
                config BSP_CHARGER_INT_PIN
                    int "Charger Detection Pin Number"
                    default 143
                config BSP_CHARGER_INT_PIN_ACTIVE_HIGH
                    bool "Detect pin level is high if charge plug in"
                    default n  
                config BSP_CHARGER_EN_PIN  
                    int "Charger Enable Pin Number"
                    default -1
                config BSP_CHARGING_PIN  
                    int "Charging Status Pin Number"
                    default -1
                config BSP_CHARGING_PIN_ACTIVE_HIGH
                    bool "Charging pin level is high if charge plug in"
                    default n   
                config BSP_CHARGE_FULL_PIN  
                    int "Charge Full Status Pin Number"
                    default -1
                config BSP_CHARGE_FULL_PIN_ACTIVE_HIGH
                    bool "Charge Full Pin Level is High if Charge Plug In"
                    default n
            endif
        menuconfig CHARGE_I2C_CONFIG
            bool "Charge I2C Config"
            default n
            
            if CHARGE_I2C_CONFIG
                config BSP_BATTERY_USE_I2C_BUS
                    string "Charge I2C Bus Config"
                    default "i2c2"
            endif   
        menuconfig CHARGE_ADC_CONFIG
            bool "Charger ADC Config"
            default y
            
            if CHARGE_ADC_CONFIG    
                config BSP_BATTERY_DETECT_ADC
                    string "Battery Measurement ADC Device Name"
                    default "bat1"
                    
                config BSP_BATTERY_DETECT_ADC_CHANNEL
                    int "Battery Measurement ADC Channel"
                    default 1
            endif
        menuconfig CHARGE_MONITOR_TEMP_CONFIG
            bool "NTC Temperature Config"
            default n
            
            if CHARGE_MONITOR_TEMP_CONFIG
                config BSP_NTC_TEMP_ADC
                    string  "NTC ADC Device Name"
                    default "bat1"
                    
                config BSP_NTC_TEMP_ADC_CHANNEL
                    int "NTC ADC Channel"
                    default 4
                    
                choice
                    prompt "NTC Value Computing Method"
                    default BSP_NTC_TEMP_METHOD_FORMULA_COMPUTE
                    
                    config BSP_NTC_TEMP_METHOD_FORMULA_COMPUTE
                    bool "Formula"
                    help
                       Compute by formula
                    
                    config BSP_NTC_TEMP_METHOD_LOOKUP_TABLE
                    bool "Lookup Table"  
                    help
                       Compute by lookup table
                endchoice
            endif
        config BSP_USING_CHARGER_DETECT
            bool "Charger Detection Enabled"
            default n
            
        config CHARGE_NO_BATTERY
            bool "Charger without Battery"
            default n
    endif
```

## customer/peripherals/display/Kconfig
```kconfig
menu "Display"

config TOUCH_WAKEUP_SUPPORT
    bool "Wake-up by Pressing Touch Panel Enabled"
    default n

endmenu
```

## customer/peripherals/key/Kconfig
```kconfig
menu "Key"
    menuconfig BSP_USING_KEY1
        bool "Use key1"
        default n
    if BSP_USING_KEY1  
        config BSP_KEY1_PIN
            int "KEY1 pin number"
            default 99
        config BSP_KEY1_ACTIVE_HIGH
            bool "Level is high if key is pressed"
            default n
    endif 
    menuconfig BSP_USING_KEY2
        bool "Use key2"
        default n
    if BSP_USING_KEY2 
        config BSP_KEY2_PIN
            int "KEY2 pin number"
            default 96
        config BSP_KEY2_ACTIVE_HIGH
            bool "Level is high if key is pressed"
            default n            
    endif    
endmenu
```

## customer/peripherals/led/Kconfig
```kconfig
menu "LED"
menuconfig BSP_USING_LED1
    bool "LED1"
    default n
    if BSP_USING_LED1  
        config BSP_LED1_PIN
            int "LED1 pin number"
            default 99
        config BSP_LED1_ACTIVE_HIGH
            bool "Level is high if LED is on"
            default n
    endif 

menuconfig BSP_USING_LED2
    bool "LED2"
    default n
    if BSP_USING_LED2
        config BSP_LED2_PIN
            int "LED2 pin number"
            default 99
        config BSP_LED2_ACTIVE_HIGH
            bool "Level is high if LED is on"
            default n
    endif 

endmenu
```

## customer/peripherals/pa/Kconfig
```kconfig
menu "Power Amplifier"

config PA_USING_AW882XX
    bool  "Digital PA AW882XX Enabled"
    default n
config PA_USING_AW87390
    bool  "Analog PA AW87390 Enabled"
    default n
    if PA_USING_AW87390
        config AW87390_GPIO_PIN
            int "AW87390 Control PIN"
            default 0
    endif 
config PA_USING_AW8155
    bool  "Analog PA AW8155 Enabled"
    default n
    if PA_USING_AW8155
        config AW8155_GPIO_PIN
            int "AW8155 Control PIN"
            default 0
    endif 

endmenu
```

## customer/peripherals/pmic_controller/Kconfig
```kconfig
menu "PMIC"

config PMIC_CTRL_ENABLE
    bool "SF30147 PMIC Controller"
    default n
    if PMIC_CTRL_ENABLE
        config PMICC_SCL_PIN
        int "PMIC Controller SCL PIN"
        default 55

        config PMICC_SDA_PIN
        int "PMIC Controller SDA PIN"
        default 44
    endif

endmenu
```

## customer/peripherals/rgb/Kconfig
```kconfig
menu "RGBLED"
menuconfig RGB_SK6812MINI_HS_ENABLE
    bool "SK6812MINI-HS RGB LED"
    default n
    if RGB_SK6812MINI_HS_ENABLE
        config RGB_USING_SK6812MINI_HS_DEV_NAME
            string "Device Name"
            default "rgbled"
        config RGB_USING_SK6812MINI_HS_PWM_DEV_NAME
            string "pwm device name"
            default "pwmt3"
        config BSP_USING_RGBLED_CH
            int "Channel"
            default "4"
        config BSP_RGB_LED_COUNT
            int "Number of RGB LEDs"
            default 1
    endif
endmenu
```
